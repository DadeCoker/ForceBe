## bos/algorithm/Kconfig
```kconfig
#算法配置
menu "Algorithm Configuration"
config _BOS_ALGO_ENABLE
    bool "Algorithm Enable/Disable"
    default y

config _ALGO_BASE64_ENABLE
    bool "Algorithm base64 Enable/Disable"
    default n
    depends on _BOS_ALGO_ENABLE

config _ALGO_SHA1_ENABLE
    bool "Algorithm SHA1 Enable/Disable"
    default n
    depends on _BOS_ALGO_ENABLE


config _ALGO_SORT_ENABLE
    bool "Algorithm Sort Enable/Disable"
    default n
    depends on _BOS_ALGO_ENABLE


config _ALGO_UNICODE_ENABLE
    bool "Algorithm Unicode Enable/Disable"
    default n
    depends on _BOS_ALGO_ENABLE


config _ALGO_MD5_ENABLE
    bool "Algorithm MD5 Enable/Disable"
    default n
    depends on _BOS_ALGO_ENABLE


config _ALGO_CRC_ENABLE
    bool "Algorithm CRC Enable/Disable"
    default n
    depends on _BOS_ALGO_ENABLE

endmenu
```

## bos/core/Kconfig
```kconfig
#版本配置，软硬件版本
config HW_VERSION
    int "Hardware version"
    default 211212

config FW_VERSION
    int "Firmware version"
    default 80202

config FW_NAME
    string "Firware Name"
    default "BabyOS"
```

## bos/drivers/Kconfig
```kconfig
#驱动配置

menu "Drivers Configuration"

config PCF8574_DEFAULT_OUTPUT
    int "PCF8574 Default Output Value"
    default 0

config MATRIX_KEYS_ROWS
    int "Maximum number of rows of matrix keys"
    default 4
config MATRIX_KEYS_COLUMNS
    int "Maximum number of columns of matrix keys"
    default 4

config ESP12F_UART_RX_BUF_LEN
    int "Uart Rx Buffer Length"
    default 1024



endmenu
```

## bos/hal/Kconfig
```kconfig
menu "Hal Configuration"
config TICK_FRQ_HZ
    int "Tick Frequncy HZ"
    default 1000

config _HALIF_VARIABLE_ENABLE
    bool "Hardware Interface Variable Enable/Disable"
    default n
endmenu
```

## bos/mcu/Kconfig
```kconfig
#选择厂商
choice
    prompt "Select Vendor"
config VENDOR_UBUNTU
    bool "ubuntu"
config VENDOR_ST
    bool "STMicroelectronics"
config VENDOR_NATION
    bool "Nationstech"
config VENDOR_MM
    bool "Mindmotion"
config VENDOR_HC
    bool "HDSC"
config VENDOR_WCH
    bool "WinChipHead"
config VENDOR_HOLTEK
    bool "holtek"
endchoice

#选择ST的芯片
choice
    prompt "Select ST Chip"
    depends on VENDOR_ST
config STM32F10X_LD
    bool "STM32F10X_LD"
config STM32F10X_MD
    bool "STM32F10X_MD"
config STM32F10X_HD
    bool "STM32F10X_HD"
config STM32F10X_CL
    bool "STM32F10X_CL"
config STM32G0X0
    bool "STM32G0X0"
config STM32L41X_L46X
    bool "STM32L41X_L46X"
endchoice

#选择国民技术的芯片
choice
    prompt "Select Nation Chip"
    depends on VENDOR_NATION
config NATION_L40X
    bool "NATION_L40X"
config NATION_G45X
    bool "NATION_G45X"
endchoice

#选择灵动微技术的芯片
choice
    prompt "Select Mindmotion Chip"
    depends on VENDOR_MM
config MM32SPIN2X
    bool "MM32SPIN2X"
config MM32SPIN0X
    bool "MM32SPIN0X"
endchoice

#选择华大半导体技术的芯片
choice
    prompt "Select HDSC Chip"
    depends on VENDOR_HC
config HC32L13X
    bool "HC32L13X"
config HC32L07X
    bool "HC32L07X"
endchoice

#选择沁恒微电子的芯片
choice
    prompt "Select WinChipHead Chip"
    depends on VENDOR_WCH
config CH32F103
    bool "CH32F103"
endchoice

#选择合泰的芯片
choice
    prompt "Select holtek Chip"
    depends on VENDOR_HOLTEK
config TH32F50343
    bool "TH32F50343"
endchoice
```

## bos/modules/Kconfig
```kconfig
#模块配置
menu "Modules Configuration"

config _BOS_MODULES_ENABLE
    bool "Modules Enable/Disable"
    default y

config _ADCHUB_ENABLE
    bool "Adchub Enable/Disable"
    default n
    depends on _BOS_MODULES_ENABLE

config FILTER_BUF_SIZE
    int "Filter Buffer Size"
    default 10
    depends on _ADCHUB_ENABLE

config _ERROR_MANAGE_ENABLE
    bool "Error Manage Enable/Disable"
    default n
    depends on _BOS_MODULES_ENABLE

config ERROR_Q_LENGTH
    int "Error Queue Length"
    default 10
    depends on _ERROR_MANAGE_ENABLE

config _MODBUS_ENABLE
    bool "Modbus Enable/Disable"
    default n
    depends on _BOS_MODULES_ENABLE
    select _BOS_ALGO_ENABLE
    select _ALGO_CRC_ENABLE

config MODBUS_BUF_SIZE
    int "Modbus Buffer Size"
    default 200
    depends on _MODBUS_ENABLE

config _PROTO_ENABLE
    bool "Protocol Enable/Disable"
    default n
    depends on _BOS_MODULES_ENABLE

config PROTO_FID_SIZE
    int "Size of The Device ID Field 2 or 4 Bytes"
    default 4
    depends on _PROTO_ENABLE
    range 1 4

config PROTO_FLEN_SIZE
    int "Size of The Len Field 1 or 2 Bytes"
    default 2
    depends on _PROTO_ENABLE
    range 1 2

config _PROTO_ENCRYPT_ENABLE
    bool "Encrypt Enable/Disable"
    default n
    depends on _PROTO_ENABLE

config SECRET_KEY1
    int "Secret Key 1"
    default 1
    depends on _PROTO_ENCRYPT_ENABLE

config SECRET_KEY2
    int "Secret Key 2"
    default 22
    depends on _PROTO_ENCRYPT_ENABLE

config SECRET_KEY3
    int "Secret Key 3"
    default 333
    depends on _PROTO_ENCRYPT_ENABLE

config SECRET_KEY4
    int "Secret Key 4"
    default 4444
    depends on _PROTO_ENCRYPT_ENABLE    


config _KV_ENABLE
    bool "KV Enable/Disable"
    default n
    depends on _BOS_MODULES_ENABLE

config _XMODEM128_ENABLE
    bool "XMODEM128 Enable/Disable"
    default n
    depends on _BOS_MODULES_ENABLE

config _YMODEM_ENABLE
    bool "YMODEM Enable/Disable"
    default n
    depends on _BOS_MODULES_ENABLE

config _MENU_ENABLE
    bool "Menu Enable/Disable"
    default n
    depends on _BOS_MODULES_ENABLE

config MENU_ITEM_NUMBER
    int "Menu Item Number"
    default 10
    depends on _MENU_ENABLE

config _TIMER_ENABLE
    bool "Soft-timer Enable/Disable"
    default n
    depends on _BOS_MODULES_ENABLE

config _PWM_ENABLE
    bool "Soft-pwm Enable/Disable"
    default n
    depends on _BOS_MODULES_ENABLE

config _PARAM_ENABLE
    bool "Tuning Parameters Enable/Disable"
    default n
    depends on _BOS_MODULES_ENABLE
    select _NR_MICRO_SHELL_ENABLE

config _STATE_ENABLE
    bool "State Machine Enable/Disable"
    default n
    depends on _BOS_MODULES_ENABLE

config _IAP_ENABLE
    bool "IAP Enable/Disable"
    default n
    depends on _BOS_MODULES_ENABLE
    select _BOS_ALGO_ENABLE
    select _ALGO_CRC_ENABLE

config MCUFLASH_BASE_ADDR
    hex "McuFlash Base Address"
    default 0x8000000
    depends on _IAP_ENABLE

config BOOT_START_ADDR
    hex "Bootloader Start Address"
    default 0x8000000
    depends on _IAP_ENABLE

config IAP_FLAG_ADDR
    hex "IAP Flag Address"
    default 0x8014000
    depends on _IAP_ENABLE

config APP_START_ADDR
    hex "App Start Address"
    default 0x8014800
    depends on _IAP_ENABLE

config RECEIVE_FIRMWARE_MODE
    int "Receive New Firmware 0(boot) 1(app)"
    default 1
    depends on _IAP_ENABLE
    range 0 1

config IAP_FILE_CACHE
    int "File Cache 0(none) 1(on-chip flash) 2(spiflash)"
    default 2
    depends on _IAP_ENABLE
    range 0 2

config IAP_FW_SAVE_ADDR
    hex "Firmware Save Address"
    default 0x0
    depends on _IAP_ENABLE

config _BACKUP_ENABLE
    bool "Backup Enable/Disable"
    default n
    depends on _IAP_ENABLE

config IAP_BACKUP_LOCATION
    int "Backup Location 0(on-chip flash) 1(spiflash)"
    default 1
    depends on _BACKUP_ENABLE
    range 0 1

config IAP_BACKUP_ADDR
    hex "Backup Address"
    default 0x32000
    depends on _BACKUP_ENABLE

config IAP_BACKUP_SIZE
    hex "Backup Area Size"
    default 0x14000
    depends on _BACKUP_ENABLE  

endmenu
```

## bos/thirdparty/Kconfig
```kconfig
#第三方代码配置
menu "Thirdparty Configuration"

config _CMBACKTRACE_ENABLE
    bool "CmbackTrace Enable/Disable"
    default n

choice
    prompt "ARM Cortex M ?"
    depends on _CMBACKTRACE_ENABLE
config TRACE_ARM_CORTEX_M0
    bool "ARM_CORTEX_M0"
config TRACE_ARM_CORTEX_M3
    bool "ARM_CORTEX_M3"
config TRACE_ARM_CORTEX_M4
    bool "ARM_CORTEX_M4"
config TRACE_ARM_CORTEX_M7
    bool "ARM_CORTEX_M7"
config TRACE_ARM_CORTEX_M33
    bool "ARM_CORTEX_M33"
endchoice

config _NR_MICRO_SHELL_ENABLE
    bool "NR Micro Shell Enable/Disable"
    default n

config NR_SHELL_USER_NAME
    string "The user's name"
    default "nr@bos:"
    depends on _NR_MICRO_SHELL_ENABLE

config NR_ANSI_LINE_SIZE
    int "ANSI command line buffer size"
    default 100
    depends on _NR_MICRO_SHELL_ENABLE

config NR_SHELL_USER_NAME_MAX_LENGTH
    int "Maximum username length"
    default 30
    depends on _NR_MICRO_SHELL_ENABLE

config NR_SHELL_CMD_PARAS_MAX_NUM
    int "Maximum number of parameters in a command"
    default 10
    depends on _NR_MICRO_SHELL_ENABLE

config NR_SHELL_MAX_CMD_HISTORY_NUM
    int "History commands 0-3"
    default 1
    depends on _NR_MICRO_SHELL_ENABLE
    range 0 3

config NR_SHELL_CMD_HISTORY_BUF_LENGTH
    int "History command cache length"
    default 100
    depends on _NR_MICRO_SHELL_ENABLE

config NR_SHELL_END_OF_LINE
    int "End of line 0(\\n) 1(\\r) 2(\\r\\n)"
    default 1
    depends on _NR_MICRO_SHELL_ENABLE
    range 0 2

config NR_SHLL_FULL_ANSI
    bool "Support all ANSI codes enable/disable"
    default y
    depends on _NR_MICRO_SHELL_ENABLE

config NR_SHELL_ECHO_ENABLE
    bool "Echo enable/disable"
    default y
    depends on _NR_MICRO_SHELL_ENABLE


config _FLEXIBLEBUTTON_ENABLE
    bool "FlexibleButton Enable/Disable"
    default n

config FLEX_BTN_SCAN_FREQ_HZ
    int "How often flex_button_scan () is called"
    default 50
    depends on _FLEXIBLEBUTTON_ENABLE

config FLEX_BTN_SHORT_XMS
    int "Short Press Time, default xms"
    default 1000
    depends on _FLEXIBLEBUTTON_ENABLE

config FLEX_BTN_LONG_XMS
    int "Long Press Time, default xms"
    default 3000
    depends on _FLEXIBLEBUTTON_ENABLE

config FLEX_BTN_LLONG_XMS
    int "LongLong Press Time, default xms"
    default 5000
    depends on _FLEXIBLEBUTTON_ENABLE    

config MULTIPLE_CLICKS_INTERVAL_XMS
    int "Multiple clicks interval, default xms"
    default 300
    depends on _FLEXIBLEBUTTON_ENABLE  


config _UGUI_ENABLE
    bool "UGUI Enable/Disable"
    default n

choice
    prompt "Font"
    depends on _UGUI_ENABLE
config GUI_FONT_6X8
    bool "FONT_6X8"
config GUI_FONT_8X12
    bool "FONT_8X12"
config GUI_FONT_12X16
    bool "FONT_12X16"
config GUI_FONT_XBF
    bool "FONT_XBF"
endchoice

choice
    prompt "Encoding"
    depends on _UGUI_ENABLE
config ENCODING_UTF_8
    bool "UTF-8"
config ENCODING_UNICODE
    bool "UNICODE"
endchoice

config XBF_FILE_ADDR
    hex "XBF Base Address"
    default 0x0
    depends on _UGUI_ENABLE


config _FS_ENABLE
    bool "FS Enable/Disable"
    default n

config _FS_TEST_ENABLE
    bool "bFS_Test() Enable/Disable"
    default y
    depends on _FS_ENABLE

choice
    prompt "FS Select"
    depends on _FS_ENABLE
config FS_FATFS
    bool "FatFS"
config FS_LITTLEFS
    bool "LittleFS"
endchoice

config _SPIFLASH_ENABLE
    bool "SPIFLASH Enable/Disable (Device No: bSPIFLASH)"
    default y
    depends on _FS_ENABLE

config SPIFLASH_SIZE
    int "SPI Flash x(MB)"
    default 8
    depends on _SPIFLASH_ENABLE

config _SD_ENABLE
    bool "SD Card Enable/Disable (Device No: bSD)"
    default n
    depends on _FS_ENABLE

config SD_SIZE_XG
    int "SD Card x(G)"
    default 1
    depends on _SD_ENABLE


config _CJSON_ENABLE
    bool "CJSON Enable/Disable"
    default n

config CJSON_MEM_USE_BMALLOC
    bool "use bMalloc and bFree ?"
    default n
    depends on _CJSON_ENABLE
    select _MEMP_ENABLE

config _COREMARK_ENABLE
    bool "COREMARK Enable/Disable"
    default n

config HAS_FLOAT
    bool "HAS_FLOAT"
    default y
    depends on _COREMARK_ENABLE

config COMPILER_VERSION
    string "compiler version"
    default "ARMCC V5.06"
    depends on _COREMARK_ENABLE

config COMPILER_FLAGS
    string "compiler flags"
    default "-O3"
    depends on _COREMARK_ENABLE

config _UNITY_ENABLE
    bool "Unity Enable/Disable"
    default n


endmenu
```

## bos/utils/Kconfig
```kconfig
menu "Utils Configuration"
config _DEBUG_ENABLE
    bool "Debug Enable/Disable"
    default y
config LOG_UART
    int "0-7:(B_HAL_UART_1-8) 8:(B_HAL_LPUART_1)"
    default 0
    depends on _DEBUG_ENABLE
    range 0 8

choice
    prompt "log level"
    depends on _DEBUG_ENABLE
    default LOG_LEVEL_INFO
    config LOG_LEVEL_INFO
        bool "info level"
    config LOG_LEVEL_WARNING
        bool "warning level"
    config LOG_LEVEL_ERROR
        bool "error level"
endchoice

config LOG_BUF_SIZE
    int "Log Buffer Size (B)"
    default 256
    depends on _DEBUG_ENABLE

config _MEMP_ENABLE
    bool "MemoryPool Enable/Disable"
    default n

config MEMP_MAX_SIZE
    int "Memory Max Size (B)"
    default 1024
    depends on _MEMP_ENABLE

endmenu
```
